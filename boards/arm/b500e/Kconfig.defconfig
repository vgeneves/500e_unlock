## boards/arm/b500e/Kconfig.defconfig
```kconfig
# b500e board


if BOARD_B500E

config BOARD
	default "b500e"

endif # BOARD_B500E
```

## drivers/ic/Kconfig
```kconfig
config IC
	bool "STM32 MCU Input Capture driver"
	default y
	depends on DT_HAS_ST_STM32_PWM_ENABLED
	select USE_STM32_LL_TIM
	select USE_STM32_LL_RCC if SOC_SERIES_STM32F4X || SOC_SERIES_STM32F7X || SOC_SERIES_STM32H7X
	help
	  This option enables the Input Capture driver for STM32 family of
	  processors.
```
